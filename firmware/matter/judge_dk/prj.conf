## CMakeLists.txt
```
#
# Matter judge node on the nRF54LM20-DK.
#
# Based on nrf/samples/matter/light_switch (Nordic-5-Clause).
#

cmake_minimum_required(VERSION 3.20.0)

find_package(Zephyr HINTS $ENV{ZEPHYR_BASE})

project(ansim-judge-dk)

# Enable GNU STD support.
include(${ZEPHYR_CONNECTEDHOMEIP_MODULE_DIR}/config/nrfconnect/app/enable-gnu-std.cmake)

# Include all source files that are located in the Matter common directory.
include(${ZEPHYR_NRF_MODULE_DIR}/samples/matter/common/cmake/source_common.cmake)

# Include Data Model utils
include(${ZEPHYR_NRF_MODULE_DIR}/samples/matter/common/cmake/data_model.cmake)

include(${ZEPHYR_NRF_MODULE_DIR}/samples/matter/common/cmake/zap_helpers.cmake)
ncs_get_zap_parent_dir(ZAP_PARENT_DIR)

# On-device anomaly model (C runtime + weights generated by firmware/anomaly/ml/train.py).
set(ANOMALY_SRC ${CMAKE_CURRENT_SOURCE_DIR}/../../anomaly/src)

target_include_directories(app PRIVATE
  src
  ${CMAKE_CURRENT_SOURCE_DIR}/../common
  ${ANOMALY_SRC}
  ${ZAP_PARENT_DIR}
)

target_compile_options(app PRIVATE -Wno-deprecated-declarations)

target_sources(app PRIVATE
  src/app_task.cpp
  src/judge.cpp
  src/main.cpp
  ${CMAKE_CURRENT_SOURCE_DIR}/../common/status_log.cpp
  src/shell_commands.cpp
  src/zcl_callbacks.cpp
  ${ANOMALY_SRC}/anomaly.c
  ${ZEPHYR_NRF_MODULE_DIR}/samples/matter/common/src/binding/binding_handler.cpp
)

# No fused multiply-add: the detector must reproduce ml/features.py bit for bit.
set_source_files_properties(${ANOMALY_SRC}/anomaly.c PROPERTIES COMPILE_OPTIONS -ffp-contract=off)

ncs_configure_data_model()
```

## Kconfig
```
#
# Matter judge node on the nRF54LM20-DK.
#
# Based on nrf/samples/matter/light_switch (Nordic-5-Clause).
#
mainmenu "Ansim Matter Judge"

config STATE_LEDS
	bool "Use LEDs to indicate the device state"
	default y
	help
	  Use LEDs to render the current state of the device such as the progress of commissioning of
	  the device into a network or the factory reset initiation.

# Same Thread/ICD setup as the light_switch sample: the data model keeps the
# ICD Management cluster, so ICD support stays on, in SIT mode with a 1 s poll.
choice OPENTHREAD_NORDIC_LIBRARY_CONFIGURATION
	default OPENTHREAD_NORDIC_LIBRARY_MTD
endchoice

choice OPENTHREAD_DEVICE_TYPE
	default OPENTHREAD_MTD
endchoice

config CHIP_ENABLE_ICD_SUPPORT
	default y

config CHIP_ICD_SLOW_POLL_INTERVAL
	default 1000

# Needed for chip::Controller::ReadAttribute on the bound sensor.
config CHIP_ENABLE_READ_CLIENT
	default y

source "$(ZEPHYR_CONNECTEDHOMEIP_MODULE_DIR)/config/nrfconnect/chip-module/Kconfig.features"
source "$(ZEPHYR_CONNECTEDHOMEIP_MODULE_DIR)/config/nrfconnect/chip-module/Kconfig.defaults"
source "$(ZEPHYR_NRF_MODULE_DIR)/samples/matter/common/src/Kconfig"
source "Kconfig.zephyr"
```

## Kconfig.sysbuild
```
#
# Sysbuild configuration for the nRF54LM20-DK: MCUboot + generated factory
# data, as in nrf/samples/matter/light_switch.
#

#### Bootloader
choice BOOTLOADER
	default BOOTLOADER_MCUBOOT
endchoice

if BOOTLOADER_MCUBOOT

#### DFU multi-image support
config DFU_MULTI_IMAGE_PACKAGE_BUILD
	default y

config DFU_MULTI_IMAGE_PACKAGE_APP
	default y

config PM_EXTERNAL_FLASH_MCUBOOT_SECONDARY
	default y

if BOARD_NRF54LM20DK

# Disable checking the external drivers for the nRF54LM20 DK.
config PM_OVERRIDE_EXTERNAL_DRIVER_CHECK
	default y

endif # BOARD_NRF54LM20DK

endif # BOOTLOADER_MCUBOOT

#### Enable generating factory data
config MATTER_FACTORY_DATA_GENERATE
	default y

source "share/sysbuild/Kconfig"
```

## prj.conf
```kconfig
# Matter
CONFIG_CHIP=y
CONFIG_CHIP_PROJECT_CONFIG="src/chip_project_config.h"
CONFIG_CHIP_DEVICE_PRODUCT_NAME="Ansim Judge"
CONFIG_NCS_SAMPLE_MATTER_ZAP_FILE_PATH="${APPLICATION_CONFIG_DIR}/src/default_zap/judge_dk.zap"

# 0x8004: example light-switch-app product ID
CONFIG_CHIP_DEVICE_PRODUCT_ID=32772
CONFIG_STD_CPP17=y

# Test commissioning values. chip-tool: pairing ... 20202021 3841
# These also feed the generated factory data.
CONFIG_CHIP_DEVICE_DISCRIMINATOR=0xF01
CONFIG_CHIP_DEVICE_SPAKE2_PASSCODE=20202021

# Advertise for commissioning as soon as the device boots unprovisioned.
CONFIG_CHIP_ENABLE_PAIRING_AUTOSTART=y
CONFIG_CHIP_BLE_EXT_ADVERTISING=y
CONFIG_CHIP_BLE_ADVERTISING_DURATION=60

# LEDs and buttons on the DK
CONFIG_DK_LIBRARY=y

# The anomaly model (firmware/anomaly) is float32 but runs in soft-float on
# purpose: CONFIG_FPU=y enables FPU_SHARING, which enlarges the exception
# frame of every thread and overflowed the stack-tuned Matter/Thread threads
# (hard fault a few minutes after boot). One inference per minute does not
# need the FPU.

# Bluetooth LE
CONFIG_BT_DEVICE_NAME="AnsimJudge"

# Suspend devices when the CPU goes into sleep
CONFIG_PM_DEVICE=y

# Other settings
CONFIG_THREAD_NAME=y
CONFIG_MPU_STACK_GUARD=y
CONFIG_RESET_ON_FATAL_ERROR=n
CONFIG_CHIP_LIB_SHELL=y
CONFIG_NCS_SAMPLE_MATTER_TEST_SHELL=y

# Reduce application size
CONFIG_USE_SEGGER_RTT=n

# Factory data (the DK has the partition for it)
CONFIG_CHIP_FACTORY_DATA=y
CONFIG_CHIP_FACTORY_DATA_BUILD=y

# Serial log: only this application's lines. The Matter stack, OpenThread
# and the rest of Zephyr stay quiet so the demo log reads as a plain
# status / measurement feed. Set MATTER_LOG_LEVEL_DBG=y to debug the stack.
CONFIG_MATTER_LOG_LEVEL_OFF=y
CONFIG_CHIP_APP_LOG_LEVEL=3
CONFIG_LOG_DEFAULT_LEVEL=1
```

## src/main.cpp
```c
/*
 * Matter judge node on the nRF54LM20-DK.
 *
 * Based on nrf/samples/matter/light_switch (Nordic-5-Clause).
 */

#include "app_task.h"

#include <zephyr/logging/log.h>

LOG_MODULE_REGISTER(app, CONFIG_CHIP_APP_LOG_LEVEL);

int main()
{
	CHIP_ERROR err = AppTask::Instance().StartApp();

	LOG_ERR("Exited with code %" CHIP_ERROR_FORMAT, err.Format());
	return err == CHIP_NO_ERROR ? EXIT_SUCCESS : EXIT_FAILURE;
}
```

## src/app_task.cpp
```c
/*
 * Matter judge node on the nRF54LM20-DK.
 *
 * Based on nrf/samples/matter/light_switch (Nordic-5-Clause).
 */

#include "app_task.h"

#include "judge.h"
#include "shell_commands.h"
#include "status_log.h"

#include "app/matter_init.h"
#include "app/task_executor.h"
#include "board/board.h"
#include "clusters/identify.h"

#include <zephyr/logging/log.h>

LOG_MODULE_DECLARE(app, CONFIG_CHIP_APP_LOG_LEVEL);

using namespace ::chip;
using namespace ::chip::app;
using namespace ::chip::DeviceLayer;

namespace
{
Nrf::Matter::IdentifyCluster sIdentifyClusterBinding(Judge::kBindingEndpointId);
Nrf::Matter::IdentifyCluster sIdentifyClusterAlarm(Judge::kAlarmEndpointId);

#ifdef CONFIG_CHIP_ICD_UAT_SUPPORT
#define UAT_BUTTON_MASK DK_BTN3_MSK
#endif
} /* namespace */

/* Buttons 1 (factory reset / software update) are handled by the board
 * module's default handler. */
void AppTask::ButtonEventHandler(Nrf::ButtonState state, Nrf::ButtonMask hasChanged)
{
#ifdef CONFIG_CHIP_ICD_UAT_SUPPORT
	if (UAT_BUTTON_MASK & state & hasChanged) {
		LOG_INF("ICD UserActiveMode has been triggered.");
		Server::GetInstance().GetICDManager().OnNetworkActivity();
	}
#else
	ARG_UNUSED(state);
	ARG_UNUSED(hasChanged);
#endif
}

CHIP_ERROR AppTask::Init()
{
	/* Initialize Matter stack. The binding manager needs the server, so the
	 * judge is initialized from the post-server-init callback. */
	ReturnErrorOnFailure(Nrf::Matter::PrepareServer(Nrf::Matter::InitData{ .mPostServerInitClbk = [] {
		Judge::Instance().Init();
		JudgeCommands::Register();
		return CHIP_NO_ERROR;
	} }));

	if (!Nrf::GetBoard().Init(ButtonEventHandler)) {
		LOG_ERR("User interface initialization failed.");
		return CHIP_ERROR_INCORRECT_STATE;
	}

	/* Register Matter event handler that controls the connectivity status LED based on the captured Matter network
	 * state. */
	ReturnErrorOnFailure(Nrf::Matter::RegisterEventHandler(Nrf::Board::DefaultMatterEventHandler, 0));
	ReturnErrorOnFailure(StatusLog::Init());

	ReturnErrorOnFailure(sIdentifyClusterBinding.Init());
	ReturnErrorOnFailure(sIdentifyClusterAlarm.Init());

	ReturnErrorOnFailure(Nrf::Matter::StartServer());
	StatusLog::PrintCurrent();
	return CHIP_NO_ERROR;
}

CHIP_ERROR AppTask::StartApp()
{
	ReturnErrorOnFailure(Init());

	while (true) {
		Nrf::DispatchNextTask();
	}

	return CHIP_NO_ERROR;
}
```

## src/app_task.h
```c
/*
 * Matter judge node on the nRF54LM20-DK.
 *
 * Based on nrf/samples/matter/light_switch (Nordic-5-Clause).
 */

#pragma once

#include "board/board.h"

#include <platform/CHIPDeviceLayer.h>

class AppTask {
public:
	static AppTask &Instance()
	{
		static AppTask sAppTask;
		return sAppTask;
	};

	CHIP_ERROR StartApp();

private:
	CHIP_ERROR Init();

	static void ButtonEventHandler(Nrf::ButtonState state, Nrf::ButtonMask hasChanged);
};
```

## src/chip_project_config.h
```c
/*
 * Project-specific overrides of the default Matter (CHIP) configuration.
 */

#pragma once

/* One CASE session to the sensor is all this node ever opens as a client. */
#define CHIP_CONFIG_CONTROLLER_MAX_ACTIVE_DEVICES 2
```

## src/judge.cpp
```c
/*
 * Reads the bound temperature sensor over Matter once per second, feeds the
 * on-device anomaly model (firmware/anomaly/src) and publishes its verdict as
 * the OnOff attribute of endpoint 2 (plus LED2 on the DK).
 */

#include "judge.h"

#include "app/task_executor.h"
#include "board/board.h"

#include <app-common/zap-generated/attributes/Accessors.h>
#include <app-common/zap-generated/ids/Clusters.h>
#include <app/clusters/bindings/binding-table.h>
#include <app/server/Server.h>
#include <controller/ReadInteraction.h>
#include <platform/CHIPDeviceLayer.h>

#include <zephyr/logging/log.h>

#include <cstdlib>

LOG_MODULE_DECLARE(app, CONFIG_CHIP_APP_LOG_LEVEL);

using namespace chip;
using namespace chip::app;
using namespace chip::app::Clusters;

namespace
{
constexpr uint32_t kReadStaleMs = 5000;
constexpr uint32_t kDaySeconds = 86400;
constexpr Nrf::DeviceLeds kAlarmLed = Nrf::DeviceLeds::LED2;

int64_t sReadRequestedUptime = 0;
bool sReadInFlight = false;
bool sSensorReachable = false;

void MarkReadDone()
{
	sReadInFlight = false;
}

void SetSensorReachable(bool reachable)
{
	if (reachable == sSensorReachable) {
		return;
	}
	sSensorReachable = reachable;
	if (reachable) {
		LOG_INF("[status] sensor connected over Thread, reading temperature every %u s", Judge::kReadIntervalMs / 1000);
	} else {
		LOG_WRN("[status] sensor not reachable");
	}
}

const char *PhaseName(uint8_t phase)
{
	switch (phase) {
	case AD_BASIC:
		return "BASIC";
	case AD_FULL:
		return "FULL";
	default:
		return "LEARNING";
	}
}

/* Scores are printed as tenths so the log needs no float printf support. */
int32_t Tenths(float value)
{
	return static_cast<int32_t>(value * 10.0f + (value >= 0.0f ? 0.5f : -0.5f));
}

int32_t Centi(float degc)
{
	return static_cast<int32_t>(degc * 100.0f + (degc >= 0.0f ? 0.5f : -0.5f));
}
} /* namespace */

void Judge::Init()
{
	Nrf::Matter::BindingHandler::Init();

	ad_init(&mState);
	SetAlarmLed(false);
	DeviceLayer::PlatformMgr().ScheduleWork(
		[](intptr_t) {
			OnOff::Attributes::OnOff::Set(kAlarmEndpointId, false);
		},
		0);

	LOG_INF("[model] anomaly detector loaded: thresholds BASIC %d.%d / FULL %d.%d, recognition %u min, state %u B",
		Tenths(ad_thr_basic) / 10, Tenths(ad_thr_basic) % 10, Tenths(ad_thr_full) / 10, Tenths(ad_thr_full) % 10,
		AD_RECOG, static_cast<unsigned int>(sizeof(mState)));

	k_timer_init(&mReadTimer, ReadTimerCallback, nullptr);
	k_timer_start(&mReadTimer, K_MSEC(kReadIntervalMs), K_MSEC(kReadIntervalMs));
}

void Judge::ReadTimerCallback(k_timer *timer)
{
	ARG_UNUSED(timer);
	Nrf::PostTask([] { RequestRead(); });
}

/* Runs on the Matter thread once per second: feeds the model, then issues one
 * read of the sensor through every unicast binding entry for the
 * TemperatureMeasurement cluster. */
void Judge::RequestRead()
{
	DeviceLayer::PlatformMgr().ScheduleWork(
		[](intptr_t) {
			Judge &judge = Instance();
			int64_t now = k_uptime_get();

			if (judge.mHaveReading && now - judge.mLastReadingUptime > kSensorSilenceMs) {
				judge.ResetDetector();
			}
			if (judge.mHaveReading) {
				judge.FeedSample(now);
			}

			if (sReadInFlight && now - sReadRequestedUptime < kReadStaleMs) {
				return;
			}

			if (Binding::Table::GetInstance().Size() == 0) {
				static bool sSaid = false;
				if (!sSaid) {
					LOG_INF("[status] no sensor bound yet, waiting for the controller to write the binding");
					sSaid = true;
				}
				return;
			}

			auto *data = Platform::New<Nrf::Matter::BindingHandler::BindingData>();
			VerifyOrReturn(data != nullptr, LOG_ERR("Out of memory for binding data"));

			data->EndpointId = kBindingEndpointId;
			data->ClusterId = TemperatureMeasurement::Id;
			data->CommandId = 0;
			data->InvokeCommandFunc = ReadBoundSensor;
			data->IsGroup.SetValue(false);

			sReadInFlight = true;
			sReadRequestedUptime = now;

			CHIP_ERROR err = Binding::Manager::GetInstance().NotifyBoundClusterChanged(
				data->EndpointId, data->ClusterId, static_cast<void *>(data));
			if (err != CHIP_NO_ERROR) {
				LOG_ERR("NotifyBoundClusterChanged failed: %" CHIP_ERROR_FORMAT, err.Format());
				MarkReadDone();
			}
		},
		0);
}

void Judge::ReadBoundSensor(const Binding::TableEntry &binding, OperationalDeviceProxy *device,
			    Nrf::Matter::BindingHandler::BindingData &bindingData)
{
	if (binding.type != Binding::MATTER_UNICAST_BINDING || device == nullptr) {
		LOG_WRN("Only unicast bindings are supported for the sensor");
		MarkReadDone();
		return;
	}

	VerifyOrDie(device->ConnectionReady());
	ARG_UNUSED(bindingData);

	using MeasuredValue = TemperatureMeasurement::Attributes::MeasuredValue::TypeInfo;

	/* The callbacks capture nothing on purpose. The binding handler's
	 * OnInvokeCommandSucces/Failure helpers each want their own heap copy of
	 * bindingData, but only the callback that fires frees its copy: one copy
	 * leaked per read and exhausted the Matter heap after ~5 minutes. The 1 s
	 * timer already retries, so no CASE recovery is needed here either. */
	auto onSuccess = [](const ConcreteDataAttributePath &path, const MeasuredValue::DecodableType &value) {
		MarkReadDone();
		SetSensorReachable(true);
		if (value.IsNull()) {
			LOG_WRN("Sensor reported a null temperature");
		} else {
			Instance().OnTemperature(value.Value());
		}
	};

	auto onFailure = [](const ConcreteDataAttributePath *path, CHIP_ERROR error) {
		MarkReadDone();
		SetSensorReachable(false);
		LOG_WRN("Reading the sensor failed: %" CHIP_ERROR_FORMAT, error.Format());
	};

	CHIP_ERROR err = Controller::ReadAttribute<MeasuredValue>(device->GetExchangeManager(),
								  device->GetSecureSession().Value(), binding.remote,
								  onSuccess, onFailure);

	if (err != CHIP_NO_ERROR) {
		LOG_ERR("Read MeasuredValue request failed: %" CHIP_ERROR_FORMAT, err.Format());
		MarkReadDone();
	}
}

void Judge::ResetDetector()
{
	LOG_WRN("[status] no reading for %u s, detector reset: recognising the space again (%u min)",
		kSensorSilenceMs / 1000, AD_RECOG);
	ad_init(&mState);
	mLastResult = { 0.0f, AD_LEARNING, 0 };
	mNormalStreak = 0;
	mHaveReading = false;
	if (mAlarmOn) {
		SetAlarm(false);
	}
}

void Judge::OnTemperature(int16_t centi)
{
	mLastReadingUptime = k_uptime_get();
	mLastTemperature = centi;
	mHaveReading = true;
}

/* Matter thread, driven by the 1 s timer rather than by arriving readings: a
 * Matter read over Thread often takes longer than a second, so the latest
 * reading is held and fed once per second to keep a 60-sample window at 60 s.
 * The DK has no wall clock, so the daily profile runs on seconds since boot
 * modulo one day: slot boundaries are offset from real time but 24 h periodic. */
void Judge::FeedSample(int64_t nowUptime)
{
	const int16_t centi = mLastTemperature;
	const uint32_t seconds = static_cast<uint32_t>(nowUptime / 1000);
	const uint32_t secOfDay = seconds % kDaySeconds;

	if (ad_feed(&mState, secOfDay, centi / 100.0f)) {
		OnWindow(ad_run_inference(&mState), centi);
	}

	if (mLastResult.phase == AD_LEARNING) {
		LOG_INF("(%02u:%02u:%02u, %d.%02d C, %s) recognising %u/%u min", seconds / 3600, (seconds / 60) % 60,
			seconds % 60, centi / 100, abs(centi % 100), mAlarmOn ? "true" : "false", mState.k, AD_RECOG);
		return;
	}

	const int32_t level = Centi(mState.L0);
	const int32_t score = Tenths(mLastResult.score);
	LOG_INF("(%02u:%02u:%02u, %d.%02d C, %s) level %d.%02d C score %d.%d [%s]", seconds / 3600,
		(seconds / 60) % 60, seconds % 60, centi / 100, abs(centi % 100), mAlarmOn ? "true" : "false",
		level / 100, abs(level % 100), score / 10, abs(score % 10), PhaseName(mLastResult.phase));
}

void Judge::OnWindow(const ad_result_t &result, int16_t centi)
{
	const uint8_t previousPhase = mLastResult.phase;
	mLastResult = result;

	if (previousPhase == AD_LEARNING && result.phase != AD_LEARNING) {
		const int32_t level = Centi(mState.L0);
		LOG_INF("[model] recognised %d.%02d C after %u min -> BASIC: judging against the recognised level",
			level / 100, abs(level % 100), AD_RECOG);
	}
	if (previousPhase == AD_BASIC && result.phase == AD_FULL) {
		LOG_INF("[model] daily profile learned -> FULL: judging against the time-of-day profile");
	}
	if (result.phase == AD_LEARNING) {
		return;
	}

	const int32_t score = Tenths(result.score);

	if (result.anomaly) {
		mNormalStreak = 0;
		if (!mAlarmOn) {
			LOG_WRN("[model] ANOMALY score %d.%d temp %d.%02d C [%s] -> alarm ON", score / 10, abs(score % 10),
				centi / 100, abs(centi % 100), PhaseName(result.phase));
			SetAlarm(true);
		}
		return;
	}

	mNormalStreak++;
	if (mAlarmOn && mNormalStreak >= kAlarmClearWindows) {
		LOG_INF("[model] normal again (score %d.%d) -> alarm OFF", score / 10, abs(score % 10));
		SetAlarm(false);
	}
}

/* Matter thread only. */
void Judge::SetAlarm(bool on)
{
	mAlarmOn = on;
	SetAlarmLed(on);

	Protocols::InteractionModel::Status status = OnOff::Attributes::OnOff::Set(kAlarmEndpointId, on);
	if (status != Protocols::InteractionModel::Status::Success) {
		LOG_ERR("Updating the alarm OnOff attribute failed %x", to_underlying(status));
	}
}

void Judge::OnAlarmAttributeWritten(bool on)
{
	SetAlarmLed(on);
}

void Judge::SetAlarmLed(bool on)
{
	Nrf::GetBoard().GetLED(kAlarmLed).Set(on);
}
```

## src/judge.h
```c
/*
 * Reads the bound temperature sensor over Matter once per second, feeds the
 * readings into the on-device anomaly model (firmware/anomaly) and publishes
 * the model's verdict as the OnOff attribute of endpoint 2 (plus an LED).
 *
 * The model works on 60-sample windows: the first 5 windows recognise the
 * space (level, swing, noise), every later window is scored against what was
 * recognised (BASIC) or, once a time of day has been learned, against the
 * daily profile (FULL).
 */

#pragma once

#include "binding/binding_handler.h"

#include "anomaly.h"

#include <app/util/basic-types.h>
#include <lib/core/CHIPError.h>

#include <zephyr/kernel.h>

class Judge {
public:
	static constexpr chip::EndpointId kBindingEndpointId = 1;
	static constexpr chip::EndpointId kAlarmEndpointId = 2;

	static constexpr uint32_t kReadIntervalMs = 1000;
	/* No reading for this long: the sample stream is broken, so the detector
	 * state is dropped and recognition starts over with the next reading. */
	static constexpr uint32_t kSensorSilenceMs = 30000;
	/* Consecutive normal windows needed before an alarm is cleared. */
	static constexpr uint32_t kAlarmClearWindows = 1;

	static Judge &Instance()
	{
		static Judge sJudge;
		return sJudge;
	}

	void Init();

	/* Called with every reading that arrived from the sensor (Matter thread).
	 * Stores it; the model is fed from the 1 s timer (FeedSample). */
	void OnTemperature(int16_t centi);

	/* Called when a controller wrote OnOff on the alarm endpoint directly. */
	void OnAlarmAttributeWritten(bool on);

	bool HasReading() const { return mHaveReading; }
	int16_t LastTemperature() const { return mLastTemperature; }
	bool AlarmOn() const { return mAlarmOn; }

	uint8_t Phase() const { return mLastResult.phase; }
	float LastScore() const { return mLastResult.score; }
	float RecognisedLevel() const { return mState.L0; }
	uint32_t WindowsCompleted() const { return mState.k; }
	uint16_t SamplesInWindow() const { return mState.n; }

private:
	static void ReadTimerCallback(k_timer *timer);
	static void RequestRead();
	static void ReadBoundSensor(const chip::app::Clusters::Binding::TableEntry &binding,
				    chip::OperationalDeviceProxy *device,
				    Nrf::Matter::BindingHandler::BindingData &bindingData);

	void ResetDetector();
	void FeedSample(int64_t nowUptime);
	void OnWindow(const ad_result_t &result, int16_t centi);
	void SetAlarm(bool on);
	void SetAlarmLed(bool on);

	k_timer mReadTimer;
	ad_state_t mState;
	ad_result_t mLastResult = { 0.0f, AD_LEARNING, 0 };
	int64_t mLastReadingUptime = 0;
	int16_t mLastTemperature = 0;
	uint32_t mNormalStreak = 0;
	bool mHaveReading = false;
	bool mAlarmOn = false;
};
```

## src/shell_commands.cpp
```c
/*
 * "judge" shell commands:
 *   judge status   last temperature, model phase, score and alarm state
 *   judge table    binding table (which sensor this node reads)
 */

#include "shell_commands.h"

#include "binding/binding_handler.h"
#include "judge.h"

#include <lib/shell/Engine.h>
#include <lib/shell/commands/Help.h>
#include <lib/shell/streamer.h>

#include <cstdlib>

#ifdef CONFIG_CHIP_LIB_SHELL

namespace JudgeCommands
{
using chip::Shell::Engine;
using chip::Shell::shell_command_t;
using chip::Shell::streamer_get;
using chip::Shell::streamer_printf;

namespace
{
Engine sSubCommands;

CHIP_ERROR HelpHandler(int argc, char **argv)
{
	sSubCommands.ForEachCommand(chip::Shell::PrintCommandHelp, nullptr);
	return CHIP_NO_ERROR;
}

CHIP_ERROR JudgeHandler(int argc, char **argv)
{
	if (argc == 0) {
		return HelpHandler(argc, argv);
	}
	return sSubCommands.ExecCommand(argc, argv);
}

int32_t Tenths(float value)
{
	return static_cast<int32_t>(value * 10.0f + 0.5f);
}

CHIP_ERROR StatusHandler(int argc, char **argv)
{
	Judge &judge = Judge::Instance();

	if (!judge.HasReading()) {
		streamer_printf(streamer_get(), "no reading from the sensor yet\r\n");
		return CHIP_NO_ERROR;
	}

	int16_t temp = judge.LastTemperature();
	streamer_printf(streamer_get(), "temp %d.%02d C, alarm %s, window %u (%u/%u samples)\r\n", temp / 100,
			abs(temp % 100), judge.AlarmOn() ? "ON" : "OFF", judge.WindowsCompleted(), judge.SamplesInWindow(),
			AD_WINDOW);

	if (judge.Phase() == AD_LEARNING) {
		streamer_printf(streamer_get(), "model: recognising the space, %u/%u min\r\n", judge.WindowsCompleted(),
				AD_RECOG);
		return CHIP_NO_ERROR;
	}

	int32_t level = static_cast<int32_t>(judge.RecognisedLevel() * 100.0f);
	int32_t score = Tenths(judge.LastScore());
	int32_t thr = Tenths(judge.Phase() == AD_FULL ? ad_thr_full : ad_thr_basic);
	streamer_printf(streamer_get(), "model: %s, recognised level %d.%02d C, score %d.%d (threshold %d.%d)\r\n",
			judge.Phase() == AD_FULL ? "FULL (daily profile)" : "BASIC (recognised level)", level / 100,
			abs(level % 100), score / 10, score % 10, thr / 10, thr % 10);
	return CHIP_NO_ERROR;
}

CHIP_ERROR TableHandler(int argc, char **argv)
{
	Nrf::Matter::BindingHandler::PrintBindingTable();
	return CHIP_NO_ERROR;
}
} /* namespace */

void Register()
{
	static const shell_command_t sSubCommandList[] = {
		{ &HelpHandler, "help", "Judge commands" },
		{ &StatusHandler, "status", "Print last temperature, model phase/score and alarm state" },
		{ &TableHandler, "table", "Print the binding table" },
	};

	static const shell_command_t sCommand = { &JudgeHandler, "judge",
						  "Temperature judge commands. Usage: judge [status|table]" };

	sSubCommands.RegisterCommands(sSubCommandList, MATTER_ARRAY_SIZE(sSubCommandList));
	Engine::Root().RegisterCommands(&sCommand, 1);
}

} /* namespace JudgeCommands */

#else

namespace JudgeCommands
{
void Register()
{
}
} /* namespace JudgeCommands */

#endif /* CONFIG_CHIP_LIB_SHELL */
```

## src/shell_commands.h
```c
#pragma once

namespace JudgeCommands
{
void Register();
}
```

## src/zcl_callbacks.cpp
```c
/*
 * Data model callbacks for the alarm endpoint (OnOff server on endpoint 2).
 */

#include "judge.h"

#include <app-common/zap-generated/attributes/Accessors.h>
#include <app-common/zap-generated/ids/Attributes.h>
#include <app-common/zap-generated/ids/Clusters.h>
#include <app/ConcreteAttributePath.h>
#include <lib/support/logging/CHIPLogging.h>

using namespace ::chip;
using namespace ::chip::app::Clusters;

void MatterPostAttributeChangeCallback(const chip::app::ConcreteAttributePath &attributePath, uint8_t type,
				       uint16_t size, uint8_t *value)
{
	if (attributePath.mEndpointId != Judge::kAlarmEndpointId) {
		return;
	}

	if (attributePath.mClusterId == OnOff::Id && attributePath.mAttributeId == OnOff::Attributes::OnOff::Id) {
		ChipLogProgress(Zcl, "Alarm OnOff set to %u", *value);
		Judge::Instance().OnAlarmAttributeWritten(*value != 0);
	}
}

void emberAfOnOffClusterInitCallback(EndpointId endpoint)
{
	bool storedValue;

	if (OnOff::Attributes::OnOff::Get(endpoint, &storedValue) == Protocols::InteractionModel::Status::Success) {
		Judge::Instance().OnAlarmAttributeWritten(storedValue);
	}
}
```
