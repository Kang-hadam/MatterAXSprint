## CMakeLists.txt
```
# SPDX-License-Identifier: Apache-2.0

cmake_minimum_required(VERSION 3.20.0)
find_package(Zephyr REQUIRED HINTS $ENV{ZEPHYR_BASE})
project(temp_sensor_dongle)

target_sources(app PRIVATE src/main.c ../common/thread_net.c)
target_include_directories(app PRIVATE ../common)
```

## Kconfig.sysbuild
```
# Do not use partition manager on nRF52840 dongle.
# The program must start after the dongle's USB bootloader.
config PARTITION_MANAGER
	default n if BOARD_NRF52840DONGLE_NRF52840

source "share/sysbuild/Kconfig"
```

## prj.conf
```kconfig
# Thread
CONFIG_OPENTHREAD=y
CONFIG_OPENTHREAD_NORDIC_LIBRARY_MASTER=y

# "ot" commands over the USB serial port
CONFIG_SHELL=y
CONFIG_OPENTHREAD_SHELL=y
CONFIG_SHELL_ARGC_MAX=26
CONFIG_SHELL_CMD_BUFF_SIZE=416

# "gpio conf gpio0 19 o0" pulls the reset line low and enters the USB bootloader
CONFIG_GPIO_SHELL=y

# Temperature sensor inside the chip
CONFIG_SENSOR=y

CONFIG_MAIN_STACK_SIZE=4096
```

## boards/nrf52840dongle_nrf52840.conf
```kconfig
CONFIG_SHELL_BACKEND_SERIAL_INIT_PRIORITY=51

CONFIG_USB_DEVICE_STACK_NEXT=y
CONFIG_CDC_ACM_SERIAL_MANUFACTURER_STRING="Nordic Semiconductor ASA"
CONFIG_CDC_ACM_SERIAL_INITIALIZE_AT_BOOT=y
CONFIG_CDC_ACM_SERIAL_PRODUCT_STRING="Thread Temp Sensor"
CONFIG_CDC_ACM_SERIAL_VID=0x1915
CONFIG_CDC_ACM_SERIAL_PID=0x0000

CONFIG_UART_LINE_CTRL=y

# Enable resetting to Bootloader using GPIO ("ot reset bootloader")
CONFIG_OPENTHREAD_PLATFORM_BOOTLOADER_MODE_GPIO=y
```

## boards/nrf52840dongle_nrf52840.overlay
```dts
&uart0 {
	status = "okay";
	hw-flow-control;
};

/ {
	/*
	 * nRF52840 dongle has pin P0.19 connected to reset. By setting it
	 * in `GPIO_OUTPUT_ACTIVE` mode, reset is pulled to GND,
	 * which results in device rebooting without skipping the bootloader.
	 * openthread_config node enables doing so using `ot reset bootloader` command.
	 */
	openthread_config: openthread {
		compatible = "openthread,config";
		bootloader-gpios = <&gpio0 19 GPIO_ACTIVE_LOW>;
	};
};
```

## src/main.c
```c
/*
 * Temperature sensor on the nRF52840 Dongle.
 *
 * Reads the temperature sensor inside the nRF52840 chip once per second
 * and sends the value to all Thread nodes.
 *
 * The green LED blinks while the dongle looks for the Thread network
 * and stays on while the dongle is attached to the network.
 */

#include <stdio.h>
#include <zephyr/kernel.h>
#include <zephyr/device.h>
#include <zephyr/drivers/gpio.h>
#include <zephyr/drivers/sensor.h>
#include <zephyr/logging/log.h>
#include <zephyr/net/openthread.h>
#include <zephyr/random/random.h>
#include <openthread/ip6.h>
#include <openthread/message.h>
#include <openthread/thread.h>
#include <openthread/udp.h>

#include "thread_net.h"

LOG_MODULE_REGISTER(temp_sensor, LOG_LEVEL_INF);

#define SEND_PERIOD_MS  1000
#define BLINK_PERIOD_MS 250

static const struct device *const temp_dev = DEVICE_DT_GET(DT_NODELABEL(temp));
static const struct gpio_dt_spec led = GPIO_DT_SPEC_GET(DT_ALIAS(led0), gpios);

static otUdpSocket udp_socket;

/* Changes at each start. The LED board turns LED0 off when it sees a new value. */
static uint32_t boot_id;

static void on_blink_timer(struct k_timer *timer)
{
	ARG_UNUSED(timer);

	gpio_pin_toggle_dt(&led);
}

static K_TIMER_DEFINE(blink_timer, on_blink_timer, NULL);

/* Read the temperature in hundredths of a degree Celsius. */
static int read_temp(int32_t *centi)
{
	struct sensor_value val;
	int ret;

	ret = sensor_sample_fetch(temp_dev);
	if (ret < 0) {
		return ret;
	}

	ret = sensor_channel_get(temp_dev, SENSOR_CHAN_DIE_TEMP, &val);
	if (ret < 0) {
		return ret;
	}

	*centi = val.val1 * 100 + val.val2 / 10000;
	return 0;
}

static bool is_attached(struct otInstance *ot)
{
	switch (otThreadGetDeviceRole(ot)) {
	case OT_DEVICE_ROLE_CHILD:
	case OT_DEVICE_ROLE_ROUTER:
	case OT_DEVICE_ROLE_LEADER:
		return true;
	default:
		return false;
	}
}

/* Blink while not attached to the network. Stay on while attached. */
static void on_thread_state_changed(otChangedFlags flags, void *user_data)
{
	ARG_UNUSED(user_data);

	if (!(flags & OT_CHANGED_THREAD_ROLE)) {
		return;
	}

	if (is_attached(openthread_get_default_instance())) {
		k_timer_stop(&blink_timer);
		gpio_pin_set_dt(&led, 1);
	} else {
		k_timer_start(&blink_timer, K_MSEC(BLINK_PERIOD_MS), K_MSEC(BLINK_PERIOD_MS));
	}
}

static struct openthread_state_changed_callback ot_state_changed_cb = {
	.otCallback = on_thread_state_changed,
};

/*
 * Send the reading and the boot ID as text,
 * for example "T=2375,B=12345" for 23.75 degrees.
 */
static otError send_temp(int32_t centi)
{
	struct otInstance *ot = openthread_get_default_instance();
	otMessageInfo info = {0};
	otMessage *msg;
	otError err;
	char payload[32];
	int len;

	len = snprintf(payload, sizeof(payload), "T=%d,B=%u", centi, boot_id);

	openthread_mutex_lock();

	if (!is_attached(ot)) {
		err = OT_ERROR_INVALID_STATE;
		goto unlock;
	}

	msg = otUdpNewMessage(ot, NULL);
	if (msg == NULL) {
		err = OT_ERROR_NO_BUFS;
		goto unlock;
	}

	err = otMessageAppend(msg, payload, len);
	if (err == OT_ERROR_NONE) {
		otIp6AddressFromString(TEMP_UDP_GROUP, &info.mPeerAddr);
		info.mPeerPort = TEMP_UDP_PORT;
		err = otUdpSend(ot, &udp_socket, msg, &info);
	}

	if (err != OT_ERROR_NONE) {
		otMessageFree(msg);
	}

unlock:
	openthread_mutex_unlock();
	return err;
}

int main(void)
{
	int32_t centi;
	otError err;
	int ret;

	if (!device_is_ready(temp_dev)) {
		LOG_ERR("Temperature sensor is not ready");
		return 0;
	}

	if (!gpio_is_ready_dt(&led) || gpio_pin_configure_dt(&led, GPIO_OUTPUT_INACTIVE) < 0) {
		LOG_ERR("LED is not ready");
		return 0;
	}

	k_timer_start(&blink_timer, K_MSEC(BLINK_PERIOD_MS), K_MSEC(BLINK_PERIOD_MS));
	openthread_state_changed_callback_register(&ot_state_changed_cb);

	boot_id = sys_rand32_get();

	openthread_mutex_lock();
	err = otUdpOpen(openthread_get_default_instance(), &udp_socket, NULL, NULL);
	openthread_mutex_unlock();
	if (err != OT_ERROR_NONE) {
		LOG_ERR("Failed to open the UDP socket [%d]", err);
		return 0;
	}

	ret = thread_net_start();
	if (ret < 0) {
		LOG_ERR("Failed to start Thread [%d]", ret);
		return 0;
	}

	while (1) {
		ret = read_temp(&centi);
		if (ret < 0) {
			LOG_ERR("Failed to read the temperature [%d]", ret);
		} else {
			err = send_temp(centi);
			LOG_INF("temp %d.%02d C, %s", centi / 100, centi % 100,
				err == OT_ERROR_NONE ? "sent" : "not sent");
		}

		k_msleep(SEND_PERIOD_MS);
	}

	return 0;
}
```
